## conf/layer.conf
```bitbake
# We have a conf and classes directory, append to BBPATH
BBPATH .= ":${LAYERDIR}"

# We have a recipes directory, add to BBFILES
BBFILES += "${LAYERDIR}/recipes*/*/*.bb ${LAYERDIR}/recipes*/*/*.bbappend"

BBFILE_COLLECTIONS += "meta-friendlyarm"
BBFILE_PATTERN_meta-friendlyarm := "^${LAYERDIR}/"
BBFILE_PRIORITY_meta-friendlyarm = "10"
LAYERSERIES_COMPAT_meta-friendlyarm = "morty pyro rocko sumo thud"
```
